## firmware/components/board/Kconfig
```kconfig
menu "Desk Console hardware"

    choice DESK_BOARD_PROFILE
        prompt "Waveshare board profile"
        default DESK_BOARD_4_3

        config DESK_BOARD_4_3
            bool "ESP32-S3-Touch-LCD-4.3"

        config DESK_BOARD_4_3_B
            bool "ESP32-S3-Touch-LCD-4.3B"
    endchoice

    config DESK_BRINGUP_DISPLAY_ON
        bool "Keep the display on during hardware bring-up"
        default n
        help
            Keeps the backlight enabled only during initial hardware bring-up.
            Runtime lock, disconnect, and heartbeat privacy actions remain active.

    config DESK_ALLOW_APP_ENROLLMENT
        bool "Allow first Mac application enrollment"
        default n
        help
            Opens first-owner enrollment and stale BLE pairing recovery. Enable it
            only for a controlled first-enrollment or recovery build, then disable
            it again after the application key has been stored in NVS.

endmenu
```
